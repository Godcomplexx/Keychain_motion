## sdkconfig.defaults
```kconfig
# BLE phone sync uses NimBLE in BLE-only mode.
CONFIG_BT_ENABLED=y
CONFIG_BT_BLUEDROID_ENABLED=n
CONFIG_BT_NIMBLE_ENABLED=y

# Release power/size profile.
CONFIG_COMPILER_OPTIMIZATION_SIZE=y
CONFIG_LOG_VERSION_2=y
CONFIG_LOG_DEFAULT_LEVEL_WARN=y
CONFIG_LOG_MAXIMUM_EQUALS_DEFAULT=y
CONFIG_PM_ENABLE=y
```
